## drivers/fingerprint/Kconfig
```kconfig
source "drivers/fingerprint/goodixgf3208/Kconfig"

source "drivers/fingerprint/goodix/Kconfig"

config FINGERPRINT
	tristate "Support for fingerprint sensor function"
	help
	  Say Y here to enable fingerprint sensor function
```

## drivers/fingerprint/goodix_5216/Kconfig
```kconfig
config FINGERPRINT_GOODIX_GF5216
	tristate "Goodix_GF5216 OEM fingerprint drvier support"
	help
	  Say Y here to enable goodix fingerprint driver support!
```
