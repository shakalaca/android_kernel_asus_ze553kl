/* Copyright (c) 2013, The Linux Foundation. All rights reserved.
 *
 * This program is free software; you can redistribute it and/or modify
 * it under the terms of the GNU General Public License version 2 and
 * only version 2 as published by the Free Software Foundation.
 *
 * This program is distributed in the hope that it will be useful,
 * but WITHOUT ANY WARRANTY; without even the implied warranty of
 * MERCHANTABILITY or FITNESS FOR A PARTICULAR PURPOSE.  See the
 * GNU General Public License for more details.
 */

/*---------------------------------------------------------------------------
 * This file is autogenerated file using gcdb parser. Please do not edit it.
 * Update input XML file to add a new entry or update variable in this file
 * VERSION = "1.0"
 *---------------------------------------------------------------------------*/
&mdss_mdp {
	dsi_rm67198_1080p_cmd: qcom,mdss_dsi_rm67198_1080p_cmd {
		qcom,mdss-dsi-panel-name = "rm67198 1080p command mode dsi panel";
		qcom,mdss-dsi-panel-controller = <&mdss_dsi0>;
		qcom,mdss-dsi-panel-type = "dsi_cmd_mode";
		qcom,mdss-dsi-panel-destination = "display_1";
		qcom,mdss-dsi-panel-framerate = <60>;
		qcom,mdss-dsi-virtual-channel-id = <0>;
		qcom,mdss-dsi-stream = <0>;
		qcom,mdss-dsi-panel-width = <1080>;
		qcom,mdss-dsi-panel-height = <1920>;
		qcom,mdss-dsi-h-front-porch = <28>;
		qcom,mdss-dsi-h-back-porch = <36>;
		qcom,mdss-dsi-h-pulse-width = <4>;
		qcom,mdss-dsi-h-sync-skew = <0>;
		qcom,mdss-dsi-v-back-porch = <20>;
		qcom,mdss-dsi-v-front-porch = <20>;
		qcom,mdss-dsi-v-pulse-width = <8>;
		qcom,mdss-dsi-h-left-border = <0>;
		qcom,mdss-dsi-h-right-border = <0>;
		qcom,mdss-dsi-v-top-border = <0>;
		qcom,mdss-dsi-v-bottom-border = <0>;
		qcom,mdss-dsi-bpp = <24>;
		qcom,mdss-dsi-color-order = "rgb_swap_rgb";
		qcom,mdss-dsi-underflow-color = <0xff>;
		qcom,mdss-dsi-border-color = <0>;
		qcom,mdss-dsi-pixel-packing = "tight";
		qcom,mdss-dsi-pixel-alignment = <0>;
		qcom,mdss-dsi-panel-orientation = "vflip";
		qcom,mdss-dsi-on-command = [29 01 00 00 00 00 02 FE D0
		29 01 00 00 00 00 02 13 40
		29 01 00 00 00 00 02 4B 4C
		29 01 00 00 00 00 02 45 42
		29 01 00 00 00 00 02 03 04
		29 01 00 00 00 00 02 04 03
		29 01 00 00 00 00 02 FE 90   
		29 01 00 00 00 00 02 12 24
		29 01 00 00 00 00 02 13 49
		29 01 00 00 00 00 02 14 92
		29 01 00 00 00 00 02 15 49
		29 01 00 00 00 00 02 16 92
		29 01 00 00 00 00 02 17 24
		29 01 00 00 00 00 02 18 24
		29 01 00 00 00 00 02 19 49
		29 01 00 00 00 00 02 1A 92
		29 01 00 00 00 00 02 1B 49
		29 01 00 00 00 00 02 1C 92
		29 01 00 00 00 00 02 1D 24
		29 01 00 00 00 00 02 1E 24
		29 01 00 00 00 00 02 1F 49
		29 01 00 00 00 00 02 20 92
		29 01 00 00 00 00 02 21 49
		29 01 00 00 00 00 02 22 92
		29 01 00 00 00 00 02 23 24
		29 01 00 00 00 00 02 A3 3A
		29 01 00 00 00 00 02 AD 00
		29 01 00 00 00 00 02 98 B7
		29 01 00 00 00 00 02 FE A0
		29 01 00 00 00 00 02 2B 18
		29 01 00 00 00 00 02 FE B0
		29 01 00 00 00 00 02 24 40   
		29 01 00 00 00 00 02 25 4F 
		29 01 00 00 00 00 02 FE 60
		29 01 00 00 00 00 02 C4 00
		29 01 00 00 00 00 02 FE 70    
		29 01 00 00 00 00 02 7D 45
		29 01 00 00 00 00 02 5D 40    
		29 01 00 00 00 00 02 86 40    
		29 01 00 00 00 00 02 5A 14
		29 01 00 00 00 00 02 5C 06
		29 01 00 00 00 00 02 52 00
		29 01 00 00 00 00 02 A7 02
		29 01 00 00 00 00 02 A9 2C
		29 01 00 00 00 00 02 BD 06
		29 01 00 00 00 00 02 D0 06
		29 01 00 00 00 00 02 E7 06
		29 01 00 00 00 00 02 FE 40
		29 01 00 00 00 00 02 64 02
		29 01 00 00 00 00 02 FE 00
		29 01 00 00 00 00 02 C2 08
		29 01 00 00 00 00 02 35 00
		29 01 00 00 00 00 02 36 01
		29 01 00 00 00 00 02 51 00
		05 01 00 00 78 00 02 11 00
		05 01 00 00 00 00 02 29 00];
		qcom,mdss-dsi-off-command = [05 01 00 00 00 00 02 28 00
					05 01 00 00 78 00 02 10 00];
		qcom,mdss-dsi-on-command-state = "dsi_lp_mode";
		qcom,mdss-dsi-off-command-state = "dsi_hs_mode";
		qcom,mdss-dsi-bkl-pwm-4pulse-command = [15 00 00 00 00 00 02 FE 60
				15 00 00 00 00 00 02 C4 80
				15 00 00 00 00 00 02 FE 70
				15 00 00 00 00 00 02 7D 35
				15 00 00 00 00 00 02 5D 60
				15 00 00 00 00 00 02 86 60
				15 00 00 00 00 00 02 5A 1E
				15 00 00 00 00 00 02 5C 36
				15 01 00 00 00 00 02 FE 00];
		qcom,mdss-dsi-bkl-pwm-6pulse-command = [15 00 00 00 00 00 02 FE 60
				15 00 00 00 00 00 02 C4 00
				15 00 00 00 00 00 02 FE 70
				15 00 00 00 00 00 02 7D 45
				15 00 00 00 00 00 02 5D 40
				15 00 00 00 00 00 02 86 40
				15 00 00 00 00 00 02 5A 14
				15 00 00 00 00 00 02 5C 06
				15 01 00 00 00 00 02 FE 00];
		qcom,mdss-dsi-h-sync-pulse = <1>;
		qcom,mdss-dsi-traffic-mode = "burst_mode";
		qcom,mdss-dsi-lane-map = "lane_map_0123";
		qcom,mdss-dsi-bllp-eof-power-mode;
		qcom,mdss-dsi-bllp-power-mode;
		qcom,mdss-dsi-tx-eot-append;
		qcom,esd-check-enabled;
		qcom,mdss-dsi-panel-status-command = [06 01 00 01 05 00 02 0A 00];
		qcom,mdss-dsi-panel-status-command-state = "dsi_lp_mode";
		qcom,mdss-dsi-panel-status-check-mode = "reg_read";
		qcom,mdss-dsi-panel-status-read-length = <1>;
		qcom,mdss-dsi-panel-max-error-count = <3>;
		qcom,mdss-dsi-panel-status-value = <0x9c>;
		qcom,mdss-dsi-lane-0-state;
		qcom,mdss-dsi-lane-1-state;
		qcom,mdss-dsi-lane-2-state;
		qcom,mdss-dsi-lane-3-state;
		qcom,mdss-dsi-te-pin-select = <1>;
		qcom,mdss-dsi-te-v-sync-rd-ptr-irq-line = <0x2c>;
		qcom,mdss-dsi-te-dcs-command = <1>;
		qcom,mdss-dsi-te-check-enable;
		qcom,mdss-dsi-te-using-te-pin;
		//qcom,mdss-dsi-panel-timings = [7d 25 1d 00 37 33 22 27 1e 03 04 00];
		qcom,mdss-dsi-panel-timings-phy-v2 = [
                23 1E 07 08 05 03 04 a0
                23 1E 07 08 05 03 04 a0
                23 1E 07 08 05 03 04 a0
                23 1E 07 08 05 03 04 a0
                23 19 07 08 05 03 04 a0];
		qcom,mdss-dsi-t-clk-post = <0x0d>;
		qcom,mdss-dsi-t-clk-pre = <0x2d>;
		qcom,mdss-dsi-bl-min-level = <1>;
		qcom,mdss-dsi-bl-max-level = <255>;
		qcom,mdss-dsi-dma-trigger = "trigger_sw";
		qcom,mdss-dsi-mdp-trigger = "none";
		qcom,mdss-dsi-bl-pmic-control-type = "bl_ctrl_dcs";
		qcom,mdss-dsi-reset-sequence = <0 0>, <0 1>, <1 5>;
		qcom,mdss-pan-physical-width-dimension=<68>;
		qcom,mdss-pan-physical-height-dimension=<121>;
	};
};
