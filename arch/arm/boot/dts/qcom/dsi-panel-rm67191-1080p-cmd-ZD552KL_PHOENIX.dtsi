/* Copyright (c) 2013, The Linux Foundation. All rights reserved.
 *
 * This program is free software; you can redistribute it and/or modify
 * it under the terms of the GNU General Public License version 2 and
 * only version 2 as published by the Free Software Foundation.
 *
 * This program is distributed in the hope that it will be useful,
 * but WITHOUT ANY WARRANTY; without even the implied warranty of
 * MERCHANTABILITY or FITNESS FOR A PARTICULAR PURPOSE.  See the
 * GNU General Public License for more details.
 */

/*---------------------------------------------------------------------------
 * This file is autogenerated file using gcdb parser. Please do not edit it.
 * Update input XML file to add a new entry or update variable in this file
 * VERSION = "1.0"
 *---------------------------------------------------------------------------*/
&mdss_mdp {
	dsi_rm67191_1080p_cmd: qcom,mdss_dsi_rm67191_1080p_cmd {
		qcom,mdss-dsi-panel-name = "rm67191 1080p command mode dsi panel";
		qcom,mdss-dsi-panel-controller = <&mdss_dsi0>;
		qcom,mdss-dsi-panel-type = "dsi_cmd_mode";
		qcom,mdss-dsi-panel-destination = "display_1";
		qcom,mdss-dsi-panel-framerate = <60>;
		qcom,mdss-dsi-virtual-channel-id = <0>;
		qcom,mdss-dsi-stream = <0>;
		qcom,mdss-dsi-panel-width = <1080>;
		qcom,mdss-dsi-panel-height = <1920>;
		qcom,mdss-dsi-h-front-porch = <26>;
		qcom,mdss-dsi-h-back-porch = <36>;
		qcom,mdss-dsi-h-pulse-width = <2>;
		qcom,mdss-dsi-h-sync-skew = <0>;
		qcom,mdss-dsi-v-back-porch = <16>;
		qcom,mdss-dsi-v-front-porch = <8>;
		qcom,mdss-dsi-v-pulse-width = <4>;
		qcom,mdss-dsi-h-left-border = <0>;
		qcom,mdss-dsi-h-right-border = <0>;
		qcom,mdss-dsi-v-top-border = <0>;
		qcom,mdss-dsi-v-bottom-border = <0>;
		qcom,mdss-dsi-bpp = <24>;
		qcom,mdss-dsi-color-order = "rgb_swap_rgb";
		qcom,mdss-dsi-underflow-color = <0xff>;
		qcom,mdss-dsi-border-color = <0>;
		qcom,mdss-dsi-pixel-packing = "tight";
		qcom,mdss-dsi-pixel-alignment = <0>;
		qcom,mdss-dsi-on-command = [29 01 00 00 00 00 02 FE 0E
					29 01 00 00 00 00 02 4B 00		
					29 01 00 00 00 00 02 4C 0F		
					29 01 00 00 00 00 02 4D 20         
					29 01 00 00 00 00 02 4E 40         
					29 01 00 00 00 00 02 4F 60         
					29 01 00 00 00 00 02 50 A0         
					29 01 00 00 00 00 02 51 C0         
					29 01 00 00 00 00 02 52 E0         
					29 01 00 00 00 00 02 53 FF
					29 01 00 00 00 00 02 FE 0D
					29 01 00 00 00 00 02 42 00         	
					29 01 00 00 00 00 02 18 08         
					29 01 00 00 00 00 02 08 41         
					29 01 00 00 00 00 02 46 02		
					29 01 00 00 00 00 02 72 09		
					29 01 00 00 00 00 02 1E 04		
					29 01 00 00 00 00 02 1E 00
					29 01 00 00 00 00 02 FE 0A
					29 01 00 00 00 00 02 24 17		
					29 01 00 00 00 00 02 04 07		
					29 01 00 00 00 00 02 1A 0C
					29 01 00 00 00 00 02 0F 44
					29 01 00 00 00 00 02 FE 0B
					29 01 00 00 00 00 02 28 40		
					29 01 00 00 00 00 02 29 4F
					29 01 00 00 00 00 02 FE 04
					29 01 00 00 00 00 02 00 0C
					29 01 00 00 00 00 02 05 10		 
					29 01 00 00 00 00 02 06 08		
					29 01 00 00 00 00 02 08 10		 
					29 01 00 00 00 00 02 09 08		
					29 01 00 00 00 00 02 0A E6
					29 01 00 00 00 00 02 0B 8C
					29 01 00 00 00 00 02 1A 12
					29 01 00 00 00 00 02 1E E0		
					29 01 00 00 00 00 02 29 93		
					29 01 00 00 00 00 02 2A 93		
					29 01 00 00 00 00 02 2F 02
					29 01 00 00 00 00 02 31 02
					29 01 00 00 00 00 02 33 05
					29 01 00 00 00 00 02 37 2D		
					29 01 00 00 00 00 02 38 2D		
					29 01 00 00 00 00 02 3A 1E		
					29 01 00 00 00 00 02 3B 1E		
					29 01 00 00 00 00 02 3D 27
					29 01 00 00 00 00 02 3F 80
					29 01 00 00 00 00 02 40 40
					29 01 00 00 00 00 02 41 E0
					29 01 00 00 00 00 02 4F 2F		
					29 01 00 00 00 00 02 50 1E
					29 01 00 00 00 00 02 FE 06
					29 01 00 00 00 00 02 00 EC
					29 01 00 00 00 00 02 05 06
					29 01 00 00 00 00 02 07 A2
					29 01 00 00 00 00 02 08 EC
					29 01 00 00 00 00 02 0D 04
					29 01 00 00 00 00 02 0F A2
					29 01 00 00 00 00 02 32 EC
					29 01 00 00 00 00 02 37 07
					29 01 00 00 00 00 02 39 83
					29 01 00 00 00 00 02 3A EC
					29 01 00 00 00 00 02 41 06
					29 01 00 00 00 00 02 43 83
					29 01 00 00 00 00 02 44 EC
					29 01 00 00 00 00 02 49 06
					29 01 00 00 00 00 02 4B A2
					29 01 00 00 00 00 02 4C EC
					29 01 00 00 00 00 02 51 04
					29 01 00 00 00 00 02 53 A2
					29 01 00 00 00 00 02 75 EC
					29 01 00 00 00 00 02 7A 07
					29 01 00 00 00 00 02 7C 83
					29 01 00 00 00 00 02 7D EC
					29 01 00 00 00 00 02 82 06
					29 01 00 00 00 00 02 84 83
					29 01 00 00 00 00 02 85 EC
					29 01 00 00 00 00 02 86 0F
					29 01 00 00 00 00 02 87 FF
					29 01 00 00 00 00 02 88 00
					29 01 00 00 00 00 02 8A 02
					29 01 00 00 00 00 02 8C A2
					29 01 00 00 00 00 02 8D EE
					29 01 00 00 00 00 02 8E 01
					29 01 00 00 00 00 02 8F E8
					29 01 00 00 00 00 02 90 0A
					29 01 00 00 00 00 02 92 06
					29 01 00 00 00 00 02 93 A0
					29 01 00 00 00 00 02 94 A8
					29 01 00 00 00 00 02 95 EC
					29 01 00 00 00 00 02 96 0F
					29 01 00 00 00 00 02 97 FF
					29 01 00 00 00 00 02 98 00
					29 01 00 00 00 00 02 9A 02
					29 01 00 00 00 00 02 9C A2
					29 01 00 00 00 00 02 A6 21
					29 01 00 00 00 00 02 A7 05
					29 01 00 00 00 00 02 A9 06
					29 01 00 00 00 00 02 AC 04
					29 01 00 00 00 00 02 B1 12
					29 01 00 00 00 00 02 B2 17
					29 01 00 00 00 00 02 B3 17
					29 01 00 00 00 00 02 B4 17
					29 01 00 00 00 00 02 B5 17
					29 01 00 00 00 00 02 B6 11
					29 01 00 00 00 00 02 B7 08
					29 01 00 00 00 00 02 B8 09
					29 01 00 00 00 00 02 B9 06
					29 01 00 00 00 00 02 BA 07
					29 01 00 00 00 00 02 BB 17
					29 01 00 00 00 00 02 BC 17
					29 01 00 00 00 00 02 BD 17
					29 01 00 00 00 00 02 BE 17
					29 01 00 00 00 00 02 BF 17
					29 01 00 00 00 00 02 C0 17
					29 01 00 00 00 00 02 C1 17
					29 01 00 00 00 00 02 C2 17
					29 01 00 00 00 00 02 C3 17
					29 01 00 00 00 00 02 C4 0F
					29 01 00 00 00 00 02 C5 0E
					29 01 00 00 00 00 02 C6 00
					29 01 00 00 00 00 02 C7 01
					29 01 00 00 00 00 02 C8 10
					29 01 00 00 00 00 02 FE 00
					29 01 00 00 00 00 02 C2 08
					29 01 00 00 00 00 02 35 00
					29 01 00 00 00 00 02 51 00
					29 01 00 00 00 00 02 44 03
					29 01 00 00 00 00 02 44 80
					05 01 00 00 78 00 02 11 00
					05 01 00 00 00 00 02 29 00];
		qcom,mdss-dsi-off-command = [05 01 00 00 32 00 02 28 00
					05 01 00 00 78 00 02 10 00];
		qcom,mdss-dsi-on-command-state = "dsi_lp_mode";
		qcom,mdss-dsi-off-command-state = "dsi_hs_mode";
		qcom,mdss-dsi-lp11-init;
		qcom,mdss-dsi-h-sync-pulse = <1>;
		qcom,mdss-dsi-traffic-mode = "burst_mode";
		qcom,mdss-dsi-lane-map = "lane_map_0123";
		qcom,mdss-dsi-bllp-eof-power-mode;
		qcom,mdss-dsi-bllp-power-mode;
		qcom,mdss-dsi-lane-0-state;
		qcom,mdss-dsi-lane-1-state;
		qcom,mdss-dsi-lane-2-state;
		qcom,mdss-dsi-lane-3-state;
		qcom,mdss-dsi-te-pin-select = <1>;
		qcom,mdss-dsi-wr-mem-start = <0x2c>;
		qcom,mdss-dsi-wr-mem-continue = <0x3c>;
		qcom,mdss-dsi-te-v-sync-rd-ptr-irq-line = <0x2c>;
		qcom,mdss-dsi-te-dcs-command = <1>;
		qcom,mdss-dsi-te-check-enable;
		qcom,mdss-dsi-te-using-te-pin;
		/*qcom,mdss-dsi-panel-timings = [7d 25 1d 00 37 33 22 27 1e 03 04 00];*/
		qcom,mdss-dsi-panel-timings-phy-v2= [
                23 1E 07 08 05 03 04 a0
                23 1E 07 08 05 03 04 a0
                23 1E 07 08 05 03 04 a0
                23 1E 07 08 05 03 04 a0
                23 18 07 08 05 03 04 a0];
		qcom,mdss-dsi-t-clk-post = <0x0d>;
		qcom,mdss-dsi-t-clk-pre = <0x2d>;
		qcom,mdss-dsi-bl-min-level = <1>;
		qcom,mdss-dsi-bl-max-level = <255>;
		qcom,mdss-dsi-dma-trigger = "trigger_sw";
		qcom,mdss-dsi-mdp-trigger = "none";
		qcom,mdss-dsi-bl-pmic-control-type = "bl_ctrl_dcs";
		qcom,mdss-dsi-reset-sequence = <1 10>;
		qcom,mdss-pan-physical-width-dimension=<68>;
		qcom,mdss-pan-physical-height-dimension=<121>;
	};
};
