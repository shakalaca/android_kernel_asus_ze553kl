/* Copyright (c) 2014-2015, The Linux Foundation. All rights reserved.
 *
 * This program is free software; you can redistribute it and/or modify
 * it under the terms of the GNU General Public License version 2 and
 * only version 2 as published by the Free Software Foundation.
 *
 * This program is distributed in the hope that it will be useful,
 * but WITHOUT ANY WARRANTY; without even the implied warranty of
 * MERCHANTABILITY or FITNESS FOR A PARTICULAR PURPOSE.  See the
 * GNU General Public License for more details.
 */



qcom,2575458_asus_hades_4850mah_averaged_masterslave_sept9th2016 {
	/* #2575458_Asus_Hades_4850mAh_averaged_MasterSlave_Sept9th2016*/
	qcom,max-voltage-uv = <4380000>;
	qcom,nom-batt-capacity-mah = <4850>;
	qcom,batt-id-kohm = <51>;
	qcom,battery-beta = <3435>;
	qcom,battery-type = "asus_hades_4850mah_sr";
	qcom,chg-rslow-comp-c1 = <4458696>;
	qcom,chg-rslow-comp-c2 = <11143200>;
	qcom,chg-rs-to-rslow = <680648>;
	qcom,chg-rslow-comp-thr = <0xCC>;
	qcom,checksum = <0x457D>;
	qcom,gui-version = "PMI8950GUI - 2.0.0.16";
	qcom,fg-profile-data = [
		 06 88 4C 7E 
		 FC 81 69 7C 
		 5C 83 38 65 
		 B2 81 38 8C 
		 44 82 0C 99 
		 CA B7 10 C8 
		 62 0E 07 88 
		 F2 7D B3 81 
		 2B 7C 5B 83 
		 B8 5A 15 81 
		 06 8D 4B 82 
		 D2 99 2F BD 
		 45 CA 5B 0E 
		 88 12 C7 59 
		 91 6F DB F9 
		 0F 37 52 46 
		 27 40 00 00 
		 3A 46 4B 39 
		 FD 36 00 00 
		 00 00 00 00 
		 00 00 00 00 
		 A5 6A 0A 6A 
		 A4 6B 6E 8A 
		 1F 7C D9 71 
		 52 6C F1 7B 
		 37 76 27 70 
		 50 76 25 A1 
		 2A 52 5A 9A 
		 57 A0 71 0C 
		 28 00 FF 36 
		 F0 11 30 03 
		 00 00 00 0C 
	];
};

